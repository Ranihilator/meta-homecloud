## conf/layer.conf
```bitbake
# We have a conf and classes directory, add to BBPATH
BBPATH =. "${LAYERDIR}:"

# We have recipes-* directories, add to BBFILES
BBFILES += "${LAYERDIR}/recipes-*/*/*.bb \
            ${LAYERDIR}/recipes-*/*/*.bbappend"

BBFILE_COLLECTIONS += "homecloud"
BBFILE_PATTERN_homecloud = "^${LAYERDIR}/"
BBFILE_PRIORITY_homecloud = "5"

LAYERSERIES_COMPAT_homecloud = "kirkstone"

# This should only be incremented on significant changes that will
# cause compatibility issues with other layers
LAYERVERSION_homecloud = "3"

LAYERDEPENDS_homecloud = "core"

REQUIRED_POKY_BBLAYERS_CONF_VERSION = "2"

DISTRO_FEATURES_BACKFILL_CONSIDERED = "pulseaudio"
IMAGE_FSTYPES += "wic.vmdk"
PSEUDO_DISABLED = "0"
#WKS_FILE = "homecloud.wks.in"
```
